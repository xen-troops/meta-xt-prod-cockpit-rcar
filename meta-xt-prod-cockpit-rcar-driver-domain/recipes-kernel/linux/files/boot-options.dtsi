/*
 * Device Tree default chosen node for systems running XEN hypervisor
 *
 * Copyright (C) 2022 EPAM Systems.
 *
 * This file is licensed under the terms of the GNU General Public License
 * version 2.  This program is licensed "as is" without any warranty of any
 * kind, whether express or implied.
 */


/ {
        chosen {
                bootargs = "loglvl=none guest_loglvl=none dom0_mem=256M console=dtuart dtuart=serial0 dom0_max_vcpus=4 bootscrub=0 sched_ratelimit_us=100 hmp-unsafe=true xsm=flask console_timestamps=boot";
        };
};
