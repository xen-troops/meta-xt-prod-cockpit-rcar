## meta-xt-native-tools/conf/layer.conf
```bitbake
# We have a conf and classes directory, add to BBPATH
BBPATH .= ":${LAYERDIR}"

# We have a packages directory, add to BBFILES
BBFILES += "${LAYERDIR}/recipes-*/*/*.bb \
            ${LAYERDIR}/recipes-*/*/*.bbappend"

BBFILE_COLLECTIONS += "xt-native-tools"
BBFILE_PATTERN_xt-native-tools := "^${LAYERDIR}/"
BBFILE_PRIORITY_xt-native-tools = "12"

LAYERSERIES_COMPAT_xt-native-tools = "dunfell"
```

## meta-xt-prod-cockpit-rcar-app/conf/layer.conf
```bitbake
# We have a conf and classes directory, add to BBPATH
BBPATH .= ":${LAYERDIR}"

# We have a packages directory, add to BBFILES
BBFILES += "${LAYERDIR}/recipes-*/*/*.bb \
            ${LAYERDIR}/recipes-*/*/*.bbappend"

BBFILE_COLLECTIONS += "xt-prod-cockpit-rcar-app"
BBFILE_PATTERN_xt-prod-cockpit-rcar-app := "^${LAYERDIR}/"
BBFILE_PRIORITY_xt-prod-cockpit-rcar-app = "12"

LAYERSERIES_COMPAT_xt-prod-cockpit-rcar-app = "dunfell"
```

## meta-xt-prod-cockpit-rcar-control/conf/layer.conf
```bitbake
# We have a conf and classes directory, add to BBPATH
BBPATH .= ":${LAYERDIR}"

# We have a packages directory, add to BBFILES
BBFILES += "${LAYERDIR}/recipes-*/*/*.bb \
            ${LAYERDIR}/recipes-*/*/*.bbappend"

BBFILE_COLLECTIONS += "xt-prod-cockpit-rcar-control"
BBFILE_PATTERN_xt-prod-cockpit-rcar-control := "^${LAYERDIR}/"
BBFILE_PRIORITY_xt-prod-cockpit-rcar-control = "12"

LAYERSERIES_COMPAT_xt-prod-cockpit-rcar-control = "kirkstone"
```
